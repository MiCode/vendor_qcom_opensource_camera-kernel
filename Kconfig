## Kconfig
```kconfig
config SPECTRA_ISP
	bool "enable camera ISP modele"
	help
	  This is enabling camera ISP module.
	  IFE camera driver file be included.
	  This will enable camera ISP driver to handle IFE driver.
	  Core camera driver to handle VFE HW.

config SPECTRA_TFE
	bool "enable camera tfe modele"
	help
	  This is enabling camera tfe module.
	  tfe module files will be included to enable tfe based driver,
	  files.

config SPECTRA_OPE
	bool "enable camera OPE modele"
	help
	  This is enabling camera OPE module.
	  Camera OPE driver file be included.
	  This will enable camera OPE driver to interact with,
	  other modules.

config SPECTRA_SENSOR
	bool "enable camera sensor modele"
	help
	  This is enabling camera sensor module.
	  sensor module files will be included to enable the driver.
	  eeprom, flash, csiphy all other module will be included
	  to make the sensor functional.
```

## blair_gki_defconfig
```kconfig
CONFIG_SPECTRA_ISP=y
CONFIG_SPECTRA_TFE=y
CONFIG_SPECTRA_OPE=y
CONFIG_SPECTRA_SENSOR=y
```

## pineapple_consolidate_defconfig
```kconfig
CONFIG_SPECTRA_ISP=y
CONFIG_SPECTRA_ICP=y
CONFIG_SPECTRA_JPEG=y
CONFIG_SPECTRA_CUSTOM=y
CONFIG_SPECTRA_SENSOR=y
CONFIG_SPECTRA_USE_CLK_CRM_API=y
CONFIG_SPECTRA_USE_RPMH_DRV_API=y
CONFIG_SPECTRA_LLCC_STALING=y
CONFIG_TARGET_SYNX_ENABLE=y
CONFIG_MSM_MMRM=y
CONFIG_INTERCONNECT_QCOM=y
```
